//Libraries and definition for Esp8266
#include <Arduino.h>
#include <ESP8266WiFi.h>
#define WIFI_SSID "HUAWEI-2.4G-58bJ"
#define WIFI_PASSWORD "J3TjP5Tu"

//Libraries and definition for RFID Reader thru SPI Connection
#include <SPI.h>
#include <MFRC522.h>
#define SS_PIN 15 //D8
#define RST_PIN 2 //D4
MFRC522 mfrc522(SS_PIN, RST_PIN);
String card_num;

// Libraries and definition for Firebase <-> ESP8266 Connection
#include <Firebase_ESP_Client.h>
#include "addons/TokenHelper.h" //Provide the token generation process info.
#include "addons/RTDBHelper.h" //Provide the RTDB payload printing info and other helper functions.
#define API_KEY "AIzaSyAjzzVsewvrDwvYG9urLB8l2F7cpRqbn5A" // Firebase project API Key
#define DATABASE_URL "https://onesync-b234d-default-rtdb.firebaseio.com/"  // RTDB URLefine the RTDB URL */

//Libraries and definition for OLED Module thru I2C
#include <Wire.h>
#include <Adafruit_GFX.h>
#include <Adafruit_SH110X.h>
#define i2c_Address 0x3c
#define SCREEN_WIDTH 128 // OLED display width, in pixels
#define SCREEN_HEIGHT 64 // OLED display height, in pixels
#define OLED_RESET -1   //   QT-PY / XIAO
Adafruit_SH1106G display = Adafruit_SH1106G(SCREEN_WIDTH, SCREEN_HEIGHT, &Wire, OLED_RESET);

//Define Firebase Data object
FirebaseData fbdo;
FirebaseAuth auth;
FirebaseConfig config;
int count = 0;
bool signupOK = false;

//Other Variable Declaration
unsigned long previousTime = 0;
int totalValue = 0;
int previousTotalValue = 0;

//Loader Bitmap
#define FRAME_DELAY (42)
#define FRAME_WIDTH (64)
#define FRAME_HEIGHT (64)
#define FRAME_COUNT (sizeof(frames) / sizeof(frames[0]))

#define LOGO16_GLCD_HEIGHT 128
#define LOGO16_GLCD_WIDTH  64
static const unsigned char PROGMEM logo16_glcd_bmp[] =
{  B00000000,B00000000,B00000000,B00000000,B00000000,B00000000,B00000000,B00000000,B00000000,B00000000,B00000000,B00000000,B00000000,B00000000,B00000000,B00000000,
  B00000000,B00000000,B00000000,B00000000,B00000000,B00000000,B00000000,B00000000,B00000000,B00000000,B00000000,B00000000,B00000000,B00000000,B00000000,B00000000,
  B00000000,B00000000,B00000000,B00000000,B00000000,B00000000,B00000000,B00000000,B00000000,B00000000,B00000000,B00000000,B00000000,B00000000,B00000000,B00000000,
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  B00000000,B00000000,B00000000,B00000000,B00000000,B00000000,B00000000,B00000000,B00000000,B00000000,B00000000,B00000000,B00000000,B00000000,B00000000,B00000000
};

void setup(){
  //Initialize the ESP8266, Serial Monitor and OLED Screen
  Serial.begin(115200);
  display.begin(i2c_Address, true);
  display.display();
  delay(500);
  display.clearDisplay();
  WiFi.begin(WIFI_SSID, WIFI_PASSWORD);               
 
  //Initialize WIFI CONNECTION
  Serial.print("Connecting to Wi-Fi");
  while (WiFi.status() != WL_CONNECTED){
    delay(300);
  }

  /* Assign the api key (required) */
  config.api_key = API_KEY;

  /* Assign the RTDB URL (required) */
  config.database_url = DATABASE_URL;

  /* Sign up */
  if (Firebase.signUp(&config, &auth, "", "")){
    Serial.println("==========================");
    Serial.println("Initialization of Device and Database Successful!");
    Serial.print("Connected with IP: ");
    Serial.println(WiFi.localIP());
    Serial.println("Firebase Connected");
    Serial.println("==========================");
    signupOK = true;
  }
  else{
    Serial.printf("Error in conneting to the Firebase. PLEASE REBOOT!");
  }

  /* Assign the callback function for the long running token generation task */
  config.token_status_callback = tokenStatusCallback; //see addons/TokenHelper.h
  
  Firebase.begin(&config, &auth);
  Firebase.reconnectWiFi(true);

  //RFID Start
  SPI.begin();
  mfrc522.PCD_Init();
}

void loop(){
  unsigned long currentTime = millis();
  int total = getTotal();
  int state = getState();
  int status;
  Serial.println(total);
  
  if(total == 0){
    display.drawBitmap(0, 0,  logo16_glcd_bmp, 128, 64, 1);
    display.display();
    display.clearDisplay();
  }

  else if(state == 1){
      display.setTextSize(2);
      display.setTextColor(SH110X_WHITE);
      display.setCursor(0, 0);
      display.println("PLEASE TAP");
      display.println("          ");
      display.println("   RFID   ");
      display.display();
      display.clearDisplay();

      if ( ! mfrc522.PICC_IsNewCardPresent() || ! mfrc522.PICC_ReadCardSerial()){
        return;
      }
      if(currentTime - previousTime >= 1000){
        card_num = getCardNumber();
        Serial.println("RFID Scanned: ");
        Serial.println("==  " + card_num + "  ==");
        Serial.println();
        getStatus();
        previousTime = currentTime;
        status = getStatus();
        delay(100);
         if(status == 1){
          display.setTextSize(2);
          display.setTextColor(SH110X_WHITE);
          display.setCursor(0, 0);
          display.println("NOT ENOUGH");
          display.println("          ");
          display.println(" BALANCE! ");
          display.display();
          delay(8500);
          display.clearDisplay();
        }

        else if(status == 2){
          display.setTextSize(2);
          display.setTextColor(SH110X_WHITE);
          display.setCursor(0, 0);
          display.println(" CARD NOT ");
          display.println("          ");
          display.println("REGISTERED");
          display.display();
          delay(8500);
          display.clearDisplay();
        }

        else if(status == 3){
          display.setTextSize(2);
          display.setTextColor(SH110X_WHITE);
          display.setCursor(0, 0);
          display.println("  PAYMENT ");
          display.println("          ");
          display.println("  SUCCESS ");
          display.display();
          delay(8500);
          display.clearDisplay();
        }

        else{
          return;
        }
      }
  }

  else if(total != previousTotalValue && state != 1){
    display.setTextSize(2);
    display.setTextColor(SH110X_WHITE);
    display.setCursor(0, 0);
    display.println("Total:    ");
    display.println("          ");
    display.setTextSize(3);
    display.print("  ");
    display.print(total);
    display.display();
    display.clearDisplay();
    previousTotalValue = total;
    return;
  }

  else{
    return;
  }
}

String getCardNumber(){
  String UID = "";
  for (byte i = 0; i < mfrc522.uid.size; i++) {
    UID += String(mfrc522.uid.uidByte[i] < 0x10 ? "0" : "");
    UID += String(mfrc522.uid.uidByte[i], HEX);
  }
  UID.toUpperCase();
  Firebase.RTDB.setString(&fbdo, "RFID/UID", UID);
  return UID;
}


int getStatus(){
  int statusValue = 0;
   if (Firebase.RTDB.getInt(&fbdo, "/RFID/Status")){
      if (fbdo.dataType() == "int"){
        statusValue = fbdo.intData();
      }
    }
    return statusValue;
}

int getTotal(){
   if (Firebase.RTDB.getInt(&fbdo, "/RFID/Total")){
      if (fbdo.dataType() == "int"){
        totalValue = fbdo.intData();
      }
    }
    return totalValue;
}

int getState(){
  int stateValue = 0;
   if (Firebase.RTDB.getInt(&fbdo, "/RFID/Tapped")){
      if (fbdo.dataType() == "int"){
        stateValue = fbdo.intData();
      }
    }
    return stateValue;
}

void printHomeScreen(){
    display.setTextSize(2);
    display.setTextColor(SH110X_WHITE);
    display.setCursor(0, 0);
    display.println("  WELCOME ");
    display.println("    TO    ");
    display.println(" ONESYNC! ");
    display.display();
    display.clearDisplay();
}
